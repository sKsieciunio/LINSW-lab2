## buildroot/package/sequencer/Config.in
```kconfig
config BR2_PACKAGE_SEQUENCER
    bool "sequencer"
    select BR2_PACKAGE_C_PHRIPHERY
    help
      Sequencer program using libperiphery and pthreads.
```
